## modules/canopennode/Kconfig
```kconfig
# CANopenNode CANopen protocol stack configuration options

# Copyright (c) 2019 Vestas Wind Systems A/S
# SPDX-License-Identifier: Apache-2.0

config ZEPHYR_CANOPENNODE_MODULE
	bool

config CANOPENNODE
	bool "CANopenNode support"
	select CRC
	depends on CAN && !CAN_FD_MODE
	help
	  This option enables the CANopenNode library.

if CANOPENNODE

config CANOPENNODE_SDO_BUFFER_SIZE
	int "CANopen SDO buffer size"
	default 32
	range 7 889
	help
	  Size of the internal CANopen SDO buffer in bytes. Size must
	  be at least equal to the size of the largest variable in the
	  object dictionary. If data type is DOMAIN, data length is
	  not limited to the SDO buffer size. If block transfer is
	  implemented, value should be set to 889.

config CANOPENNODE_TRACE_BUFFER_SIZE
	int "CANopen trace buffer size"
	default 100
	help
	  Size of the CANopen trace buffer in bytes.

config CANOPENNODE_TX_WORKQUEUE_STACK_SIZE
	int "Stack size for the CANopen transmit workqueue"
	default 512
	help
	  Size of the stack used for the internal CANopen transmit
	  workqueue.

config CANOPENNODE_TX_WORKQUEUE_PRIORITY
	int "Priority for CANopen transmit workqueue"
	default 0 if !COOP_ENABLED
	default -1
	help
	  Priority level of the internal CANopen transmit workqueue.

config CANOPENNODE_MULTIPLE_OD
	bool "CANopen multiple object dictionaries"
	default y
	help
	  Enable support for multiple object dictionaries.

config CANOPENNODE_MULTIPLE_OD_MAX_COUNT
	int "Maximum number of CANopen object dictionaries"
	default 1
	range 1 4
	depends on CANOPENNODE_MULTIPLE_OD
	help
	  Maximum number of object dictionaries supported.

endif # CANOPENNODE
```
